## projects/Kconfig
```kconfig
config PROJECTS
	bool "Enable project-specific configurations"
	default n

choice
	prompt "Select project"
	default PROJECT_SMILE
	depends on PROJECTS

config PROJECT_SMILE
	bool "SMILE DPU"
	depends on LEON3 && ARCH_CUSTOM_BOOT_CODE
	help
	 Configure DPU-specific setup for SMILE

config PROJECT_ARIEL
	bool "ARIEL DPU"
	depends on LEON3 && ARCH_CUSTOM_BOOT_CODE
	help
	 Configure DPU-specific setup for ARIEL

config PROJECT_RAMSES
	bool "RAMSES DPU"
	depends on LEON3 && ARCH_CUSTOM_BOOT_CODE
	help
	 Configure DPU-specific setup for RAMSES

config PROJECT_MYAPP
	bool "MYAPP_DEMO"
	depends on (LEON3 || LEON4) && ARCH_CUSTOM_BOOT_CODE
	help
	 Demonstrate loading of an application software

endchoice


menu "RAMSES WORKAROUNDS"
	depends on PROJECT_RAMSES

config RAMSES_EM_2
	bool "EM-2 EDAC workaround"
	default n
	help
	 If selected, does not acknowledge EDAC error bits in AHB status register
	 to prevent the unknown source of single-bit errors on EM-2 from
	 triggering an IRQ.
endmenu
```
