## Kconfig
```kconfig
#
# For a description of the syntax of this configuration file,
# see Documentation/kbuild/kconfig-language.txt.
#
mainmenu "LeanOS Configuration"

config SRCARCH
	string
	option env="SRCARCH"

source "lib/Kconfig"
source "arch/$SRCARCH/Kconfig"

source "samples/Kconfig"
```

## arch/sparc/Kconfig
```kconfig
menu "SPARC Configuration"

### Arch specific settings

config PAGE_OFFSET
	bool "Use an offset in physical/virtual page address conversion"
	default n
	help
	  Use an offset when computing the virtual and physical page
	  addresses. This can not work unless the kernel is bootstrapped.
	  If unsure, say N.

config EXTRA_SPARC_PHYS_BANKS
	int "Number of extra physical memory banks"
	default 0
	range 0 31
	help
	 Set number of additional physical memory banks if the machine has more
	 than one.

menu "Memory Management Settings"
	depends on MM
	depends on CHUNK

config SPARC_MM_BLOCK_ORDER_MAX
	int "Initial memory block order upper limit"
	depends on MM
	default 26
	range 6 32
	help
	  The upper limit order (i.e. 2^N bytes) of the largest trackable memory
	  block. If unsure, set this to the size order of your largest single
	  memory bank.
	  Allowed order range is 6 to 31.

config SPARC_MM_BLOCK_ORDER_MIN
	int "Initial memory block order lower limit"
	depends on MM
	default 12
	range 5 30
	help
	  The lower limit order (i.e. 2^N bytes) of the smallest trackable
	  memory block. If unsure, choose the page size of the platform.
	  Allowed order range is 5 to 30.

config SPARC_INIT_PAGE_MAP_MAX_ENTRIES
	int "Maximum number of mappings in initial page map"
	depends on MM
	default 8
	range EXTRA_SPARC_PHYS_BANKS 32
	help
	  Configures the storage space for the initial page map. It's wise to
	  say at least EXTRA_SPARC_PHYS_BANKS here.

config SPARC_BOOTMEM_RESERVE_CHUNK_ORDER
	int "Memory block order to reserve for boot memory allocator"
	depends on MM
	depends on CHUNK
	default 20
	range  12 SPARC_MM_BLOCK_ORDER_MAX
	help
	  The order (i.e. 2^N bytes) of memory to reserve for the boot memory
	  allocator in a single request to the higher-tier memory manager.
	  The boot memory allocator is used by low level functionality, such as
	  the mangement of MMU translation tables, so choose a large enough
	  number. The default (20, i.e. 1 MiB) is a good starting point.
	  Allowed order range is 12 (SPARC page size) to
	  SPARC_MM_BLOCK_ORDER_MAX.

config SPARC_BOOTMEM_REQUEST_NEW_ON_DEMAND
	bool "Allow the boot memory allocator to request new memory blocks"
	depends on MM
	depends on CHUNK
	default y
	help
	 Allow the boot memory allocator to request new blocks of size
	 SPARC_BOOTMEM_RESERVE_CHUNK_ORDER from the higher-tier memory manager.
	 Beware that this will potentially lead to greater memory fragmentation.
	 If unsure, say Y.
endmenu



endmenu


# other

source "init/Kconfig"

source "kernel/Kconfig"

source "lib/Kconfig"
```

## init/Kconfig
```kconfig
config ARCH
	string
	option env="ARCH"

config KERNELVERSION
	string
	option env="KERNELVERSION"



menu "General Setup"

config KALLSYMS
	bool "Generate a kernel symbol table"
	default y
	help
	  Create a kernel image symbol lookup table for use in loadable modules.
	  Note: If disabled, modules can still export symbols for other modules
	  to use, but no kernel functions will be resolvable.
	  If unsure, say Y.


config CROSS_PLATFORM_TARGET
	bool "Cross-compile for different platform"
	default y
	help
	 Compile for different target platform.

config CROSS_COMPILE
	string "Cross-compiler tool prefix"
	default "" if !CROSS_PLATFORM_TARGET
	default "sparc-elf-" if CROSS_PLATFORM_TARGET
	help
	  Same as running 'make CROSS_COMPILE=prefix-' but stored for
	  default make runs in this kernel build directory.  You don't
	  need to set this unless you want the configured kernel build
	  directory to select the cross-compiler automatically.

config TARGET_COMPILER_BOOT_CODE
	bool "Use target compiler's boot/startup code"
	default y if CROSS_PLATFORM_TARGET
	help
	  Use the compiler-provided boot code (e.g. BCC target)

endmenu # "General Setup"


menuconfig MODULES
	bool "Enable loadable module support"
	depends on AR
	option modules
	help
	  Kernel modules are small pieces of compiled code which can
	  be inserted in the running kernel, rather than being
	  permanently built into the kernel.  You use the "modprobe"
	  tool to add (and sometimes remove) them.  If you say Y here,
	  many parts of the kernel can be built as modules (by
	  answering M instead of Y where indicated): this is most
	  useful for infrequently used options which are not required
	  for booting.  For more information, see the man pages for
	  modprobe, lsmod, modinfo, insmod and rmmod.

	  If you say Y here, you will need to run "make
	  modules_install" to put the modules under /lib/modules/
	  where modprobe can find them (you may need to be root to do
	  this).

	  If unsure, say Y.

if MODULES

config EMBED_MODULES_IMAGE
	bool "Embed an image with all generated loadable modules"
	help
	  Enable this option in order to embed an image containing all
	  generated modules into the final kernel binary.
	  This is a convenience option, if unsure, say Y.

endif # MODULES


config BUILD_XEN_KERNELS
	bool "Build Xentium DSP kernel programs"
	help
	  Enable this option in order to build the Xentium kernel programs
	  in dsp/xentium.

config XENTIUM_PROC_DEMO
	bool "Build a Xentium Processing Demo kernel"
	depends on BUILD_XEN_KERNELS && XENTIUM
	help
	  Enable this option in order to build a kernel that runs a Xentium
	  processing demo.


menu "Compile-time checks and compiler options"

choice
	prompt "Compiler optimization level"
	default CONFIG_CC_OPTIMIZE_FOR_PERFORMANCE

config CC_OPTIMIZE_FOR_PERFORMANCE
	bool "Optimize for performance"
	help
	  This is the default optimization level for the kernel, building
	  with the "-O2" compiler flag for best performance and most
	  helpful compile-time warnings.

config CC_OPTIMIZE_FOR_SIZE
	bool "Optimize for size"
	help
	  Enabling this option will pass "-Os" instead of "-O2" to
	  your compiler resulting in a smaller kernel.

	  If unsure, say N.

config CC_OPTIMIZE_NONE
	bool "No optimization"
	help
	  Enabling this option will pass "-O0" to the compiler.
	  This should be avoided, some things may not work as expected or at
	  all if the rely on -O2 or -Os. You have been warned.

	  If unsure, say N.

endchoice

config DEBUG_INFO
	bool "Compile the application with debug info"
	help
          If you say Y here the resulting application binary will include
	  debugging info resulting in a larger application binary.
	  This adds debug symbols to the application (gcc -g), and
	  is needed if you want to debug your application with gdb.
	  Say Y here only if you plan to debug the application.

	  If unsure, say N.

config DEBUG_INFO_REDUCED
	bool "Reduce debugging information"
	depends on DEBUG_INFO
	help
	  If you say Y here gcc is instructed to generate less debugging
	  information for structure types. This means that tools that
	  need full debugging information (like gdb or systemtap) won't
	  be happy. But if you merely need debugging information to
	  resolve line numbers there is no loss. Advantage is that
	  build directory object sizes shrink dramatically over a full
	  DEBUG_INFO build and compile times are reduced too.
	  Only works with newer gcc versions.

endmenu
```

## kernel/Kconfig
```kconfig
config KERNEL_PRINTK
	bool "Enable printing in kernel"
	default y

config KERNEL_LEVEL
	int "Kernel debug level"
	default "7"
	range 0 8
	depends on KERNEL_PRINTK
	help
	 Limit the kernel's debug message level:
	 1: emergency
	 2: alerts
	 3: critical conditions
	 4: error conditions
	 5: warnings
	 6: notices
	 7: informational
	 8: debug

config IRQ_STATS_COLLECT
	bool "Enable IRQ statistics via sysctl"
	depends on SYSCTL
	default n
	help
	 Collect interrupt statistics and expose them in the
	 sysctl tree.

config CPU_STATS_COLLECT
	bool "Enable CPU statistics via sysctl"
	depends on SYSCTL
	default n
	help
	 Expose cpu loads in the sysctl tree.

config TASK_PREEMPTION_DISABLE
	bool "Disable forced preemption of tasks"
	default n
	help
	 Say Y here to change the task system to be collaborative, i.e.
	 for voluntary yields and run-to-completion. Note that this does not
	 mean that tasks can not be preempted at all, just that there will
	 be no supervisor to instigate such an event. Any IRQs will still
	 preempt a running task, as will blocked I/O and locking operations.
	 The latter may result in a rescheduling events to prevent priority
	 inversion etc.
	 WARNING: Currently unstable. Use for development only. You have been warned.

config SOC
	bool "Enable System-On-Chip configurations"
	default n

choice
	prompt "Select board type"
	default MPPB
	depends on SOC

config MPPB
	bool "MPPBv2"
	depends on SOC && LEON2
	help
	 Configure parameters for the MPPBv2

config SSDP
	bool "SSDP"
	depends on SOC && LEON3
	help
	 Configure parameters for the SSDP

endchoice

menu "System-on-Chip drivers"

depends on SOC



config NOC_DMA
	tristate "NoC 2D DMA driver"
	default y
	depends on SOC && (MPPB || SSDP)
	help
	 Build the MPPBv2/SSDP NoC DMA driver.

config NOC_DMA_TRANSFER_QUEUE_SIZE
	int "NoC DMA transfer queue size"
	default "32"
	depends on NOC_DMA
	help
	 Configures the size of the DMA transfer queue.

config NOC_DMA_STATS_COLLECT
	bool "Enable NoC DMA statistics via sysctl"
	depends on SYSCTL
	default n
	help
	 Collect DMA transfer statistics and expose them in the
	 systl tree.

config NOC_DMA_SAME_MASTER_TRANSFER_WORKAROUND
	bool "Enable workaround for NoC DMA transfers within same master"
	default n
	help
	 Enable a workaround for NoC DMA transfers with the address space
	 of the same master. On the MPPB this will result in a stuck channel,
	 as the transfer never completes. If you say Y here, the requested
	 transfer will be initialised as two transfers, one of high priority
	 that copies the source data into a scratch buffer (the NoC SRAM tile)
	 and a low priority transfer that copies the contents of the scratch
	 buffer to the destination. Results may be unpredictable,
	 you have been warned.

config XENTIUM
	tristate "Xentium processing network support"
	default y
	depends on NOC_DMA
	help
	 Build the driver to operate a Xentium processing network

endmenu

config TESTMODULE
	tristate "a test module"
	default m
	depends on SYSCTL
	help
	 an example module for testing of the module loader
```

## lib/Kconfig
```kconfig
menu "Core Components"

config SYSCTL
	bool "sysctl interface"
	default y
	help
	  Enable use of the sysctl interface.

config MM
	bool "Memory Management"
	default y
	help
	  Enable use of the memory block management system. See the
	  platform-specific settings menu for configuration options.
	  Please note that the choices you make can have significant impact on
	  the memory footprint of the tracker, since each minimum block unit
	  requires one bit to track its usage status. For example, with an
	  upper block order of 32 and a lower block order of 12, i.e. a memory
	  size of 4 GiB and a page size of 4 kiB requires bit map space of
	  1 MiB.


menu "Memory Management Page Return Options"
        depends on MM

config KMEM_RELEASE_UNUSED
	depends on MMU
	bool "Release unused memory chunks by rewinding the system break"
	default y

config KMEM_RELEASE_UNUSED_LAZY
	depends on KMEM_RELEASE_UNUSED
	bool "Release only a limited number of pages at once"
	default y

config PAGES_RELEASE_MAX
	int "Maximum number of pages to return at once"
	depends on KMEM_RELEASE_UNUSED_LAZY
	default 10
	help
	  Limit the number of pages released back to the system break.
	  This prevents extra time spent releasing pages when deallocating very
	  large memory buffers. The remaining unused memory will be naturally
	  released over time during subsequent kmalloc()/kfree() calls or
	  in the background by if KMEM_RELEASE_BACKGROUND is enabled
	  Note: if set to 0, RELEASE_UNUSED_LAZY is effectively disabled
	  Beware: if KMEM_RELEASE_BACKGROUND is enabled, leave this number in
	  the low 10s

config KMEM_RELEASE_BACKGROUND
	depends on KMEM_RELEASE_UNUSED_LAZY
	bool "Release unused memory chunks in the background"
	default y
endmenu


menu "Memory Management Debug Options"
        depends on MM

config MM_DEBUG_DUMP
	bool "Enable Memory Management debug dump"
	default n
	help
	  Dump allocation info for the memory manager.

config MM_DEBUG_DUMP_ALLOC_BITMAP
	depends on MM_DEBUG_DUMP
	bool "Dump block allocation bitmap"
	default n
	help
	  Dump the granularity-level block allocation bitmap.

config MM_DEBUG_DUMP_BLOCK_ALLLOC
	depends on MM_DEBUG_DUMP
	bool "Dump block allocation orders"
	default n
	help
	  Dump the allocation order for each block at block granularity.

config MM_DEBUG_DUMP_BLOCK_STATS
	depends on MM_DEBUG_DUMP
	bool "Dump block allocation statistics"
	default n
	help
	  Dump the allocation statistics for each block order.
endmenu


config PAGE_MAP
	bool "Page Map"
	depends on MM
	default y
	help
	  Enable page map management. Can hold multiple nodes and returns
	  references to pages as configured per each node.

menu "Page Map Options"
	depends on PAGE_MAP

config PAGE_MAP_CHECK_PAGE_ALIGNMENT
	depends on PAGE_MAP
	bool "Extra check for alignment in page address"
	default n
	help
	  Make sure the address of the allocated page is really aligned
	  to the page size of the underlying memory manager. This does not
	  prevent misconfiguration, just adds a functional verification step.

config PAGE_MAP_MOVE_NODE_AVAIL_THRESH
	depends on PAGE_MAP
	int "Threshold for empty page node to be considered filled again"
	default 1
	range 1 1024
	help
	  When page map node run out of pages, they are moved to a list of
	  empty nodes until a number of pages are freed, defined by the
	  threshold above. If unsure, use a threshold of 1.
endmenu


config CHUNK
	bool "Memory Chunk Manager"
	default y
	help
	 Manages smaller than page-sized allocations with memory supplied by
	 a higher-tier memory-manager. This is a stepping stone to malloc(),
	 if unsure, say Y


config AR
	bool "AR archive loading support"
	default y
	help
	  Enable loading of SVR4/GNU style AR archives.

endmenu
```

## samples/Kconfig
```kconfig
menuconfig SAMPLES
	bool "Sample and demo code"
	help
	  You can build and test example code here.

if SAMPLES

config SAMPLE_SYSCTL
	bool "Build sysctl sample code"
	depends on SYSCTL
	help
	  Build a sample demonstrating the use of the sysctl tree.

config SAMPLE_MM
	bool "Build memory management sample code"
	depends on MM
	help
	  Build a sample demonstrating the use of the memory management system.

config SAMPLE_CHUNK
	bool "Build chunk memory allocator sample code"
	depends on CHUNK
	help
	  Build a sample demonstrating the use of the chunk memory allocator.

config SAMPLE_PROC_CHAIN
	bool "Build processing chain sample code"
	help
	  Build a sample demonstrating how to create a processing chain. 

config SAMPLE_NOC_DMA
	bool "Build NoC DMA sample code"
	depends on NOC_DMA
	help
	  Build a sample demonstrating how to use the NoC DMA interface.

endif # SAMPLES
```
